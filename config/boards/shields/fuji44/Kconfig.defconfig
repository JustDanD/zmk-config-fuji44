## config/boards/shields/fuji44/Kconfig.defconfig
```kconfig
if SHIELD_FUJI44_LEFT

config ZMK_KEYBOARD_NAME
    default "Fuji44"

config ZMK_SPLIT_ROLE_CENTRAL
    default y

endif

if SHIELD_FUJI44_LEFT || SHIELD_FUJI44_RIGHT

config ZMK_SPLIT
    default y

endif

if SHIELD_FUJI44_QUBE

config ZMK_KEYBOARD_NAME
    default "Fuji44 Qube"

config ZMK_SPLIT
    default y

config ZMK_SPLIT_ROLE_CENTRAL
    default y

config ZMK_SPLIT_BLE_CENTRAL_PERIPHERALS
    default 2

config BT_MAX_CONN
    default 7

config BT_MAX_PAIRED
    default 7

endif
```

## config/west.yml
```yaml
manifest:
  remotes:
    - name: zmkfirmware
      url-base: https://github.com/zmkfirmware
    - name: ergohaven
      url-base: https://github.com/ergohaven

  projects:
    - name: zmk
      remote: zmkfirmware
      revision: v0.3.0
      import: app/west.yml

    - name: ergohaven-zmk
      remote: ergohaven
      revision: main

    - name: ergohaven-zmk-qube
      remote: ergohaven
      revision: eh

  self:
    path: config
```
